/*
 * firmware.c — Cortex-M3 generation demo for the Atome engine.
 *
 * Differences from cortex-m3/firmware.c:
 *   - Runs `atome_predict_next` in a loop, appending each generated
 *     argmax token to a shared buffer (one shot of generation, not just
 *     one forward pass).
 *   - Streams each generated byte over semihosting as it arrives.
 *   - Reports total elapsed cycles via the Cortex-M3 DWT counter so the
 *     host harness can compute tokens/sec without needing wall-clock.
 *
 * Compile-time ATOME_* defines come from the Makefile, identical to the
 * single-forward firmware. The model blob is provided by `model_data.h`
 * generated at build time by `xxd -i model.atome > model_data.h`.
 */

#include "atome.h"
#include "model_data.h"

#include <stdio.h>
#include <stdint.h>
#include <stdlib.h>


/* Cortex-M3 DWT (Data Watchpoint and Trace) cycle counter — free
 * monotonic clock on every M3+. We turn it on once at boot. */
#define DWT_CYCCNT  (*(volatile uint32_t *)0xE0001004)
#define DWT_CTRL    (*(volatile uint32_t *)0xE0001000)
#define DEMCR       (*(volatile uint32_t *)0xE000EDFC)
#define TRCENA_BIT  (1u << 24)
#define CYCCNTENA   (1u << 0)


static void dwt_init(void) {
    DEMCR |= TRCENA_BIT;
    DWT_CYCCNT = 0;
    DWT_CTRL |= CYCCNTENA;
}

static atome_model_t g_model;
static atome_state_t g_state;

/* User-overridable via Makefile DEFINES. */
#ifndef DEMO_PROMPT_LEN
#define DEMO_PROMPT_LEN 4
#endif
#ifndef DEMO_NEW_TOKENS
#define DEMO_NEW_TOKENS 8
#endif

/* Hardcoded prompt — short, deterministic, mirrors the host harness.
 * The wrapper script can override by passing -DATOME_USE_PROMPT_HEADER
 * and dropping a `prompt_data.h` next to model_data.h that defines
 * kPrompt[] at file scope (e.g. for byte-tokenizer text prompts). */
static int g_tokens[ATOME_MAX_SEQ];

#ifdef ATOME_USE_PROMPT_HEADER
#include "prompt_data.h"
#else
static const int kPrompt[DEMO_PROMPT_LEN] = {10, 20, 5, 17};
#endif

void _init(void) {}
void _fini(void) {}

int main(void) {
    dwt_init();

    /* Build the prompt. The host can verify by feeding the same ids. */
    for (int i = 0; i < DEMO_PROMPT_LEN; ++i) g_tokens[i] = kPrompt[i];
    int n_tokens = DEMO_PROMPT_LEN;

    if (atome_load(&g_model, model_atome, model_atome_len) != 0) {
        printf("ERROR: atome_load failed\n");
        return 1;
    }
    atome_init(&g_state);

    printf("ATOME-GEN-START prompt_len=%d new_tokens=%d max_seq=%d\n",
           DEMO_PROMPT_LEN, DEMO_NEW_TOKENS, ATOME_MAX_SEQ);

    uint32_t cyc0 = DWT_CYCCNT;

    for (int step = 0; step < DEMO_NEW_TOKENS; ++step) {
        if (n_tokens >= ATOME_MAX_SEQ) {
            printf("WARN: hit ATOME_MAX_SEQ; stopping early\n");
            break;
        }
        int next = atome_predict_next(&g_model, &g_state, g_tokens, n_tokens);
        g_tokens[n_tokens++] = next;
        printf("TOK %d %d\n", step, next);
    }

    uint32_t cyc1 = DWT_CYCCNT;
    uint32_t total_cycles = cyc1 - cyc0;
    /* Host computes tokens/sec via cycles / (clock_hz * tokens). */
    printf("ATOME-GEN-END total_cycles=%u tokens=%d\n",
           (unsigned)total_cycles, DEMO_NEW_TOKENS);
    return 0;
}
