## hardware/esp32-wroom32/firmware/sdkconfig.defaults
```kconfig
# Base defaults (no PSRAM here — see sdkconfig.psram overlay for the 944K/full build).
# atome.sh layers an overlay per profile via SDKCONFIG_DEFAULTS.

# --- partition table (2MB app, see partitions.csv) ---
CONFIG_PARTITION_TABLE_CUSTOM=y
CONFIG_PARTITION_TABLE_CUSTOM_FILENAME="partitions.csv"

# --- flash (4MB; fits all our boards). 80MHz ~doubles weight-read speed. ---
CONFIG_ESPTOOLPY_FLASHSIZE_4MB=y
CONFIG_ESPTOOLPY_FLASHMODE_DIO=y
CONFIG_ESPTOOLPY_FLASHFREQ_80M=y

# --- max clock: model is flash/compute-bound, so run the core flat out ---
CONFIG_ESP_DEFAULT_CPU_FREQ_MHZ_240=y
CONFIG_ESP_DEFAULT_CPU_FREQ_MHZ=240

# --- performance ---
CONFIG_COMPILER_OPTIMIZATION_PERF=y
CONFIG_ESP_MAIN_TASK_STACK_SIZE=8192

# --- console on the default USB-serial/UART ---
CONFIG_ESP_CONSOLE_UART_DEFAULT=y
CONFIG_ESP_CONSOLE_UART_BAUDRATE=115200
```

## superesp/esp32/firmware/sdkconfig.defaults
```kconfig
# SuperESP battery — ESP32-WROOM-32 profile (the board we tested first).
# No PSRAM; tiny state (~27 KB) lives in internal SRAM with huge headroom.
CONFIG_ESP_MAIN_TASK_STACK_SIZE=8192
CONFIG_ESP_TASK_WDT_INIT=n
CONFIG_ESP_DEFAULT_CPU_FREQ_MHZ_240=y
CONFIG_ESPTOOLPY_FLASHSIZE_4MB=y
# Larger factory app partition: battery_data.h bakes all 12 blobs (~80 KB rodata).
CONFIG_PARTITION_TABLE_SINGLE_APP_LARGE=y
```

## superesp/esp32/firmware_agri/sdkconfig.defaults
```kconfig
CONFIG_ESP_MAIN_TASK_STACK_SIZE=8192
CONFIG_ESP_TASK_WDT_INIT=n
CONFIG_ESP_DEFAULT_CPU_FREQ_MHZ_240=y
CONFIG_ESPTOOLPY_FLASHSIZE_4MB=y
CONFIG_PARTITION_TABLE_SINGLE_APP_LARGE=y
```

## superesp/esp32/firmware_logger/sdkconfig.defaults
```kconfig
CONFIG_ESP_TASK_WDT_INIT=n
CONFIG_ESP_DEFAULT_CPU_FREQ_MHZ_240=y
CONFIG_ESPTOOLPY_FLASHSIZE_4MB=y
```
